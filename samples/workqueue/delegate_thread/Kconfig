## samples/workqueue/delegate_thread/Kconfig
```kconfig
# Copyright (c) Nordic Semiconductor ASA
# SPDX-License-Identifier: Apache-2.0

source "Kconfig.zephyr"

config SAMPLE_INST_COUNT
	int "Number of instances to spawn"
	default 255
```

## samples/workqueue/delegate_thread_nomacro/Kconfig
```kconfig
# Copyright 2024 (c) Nordic Semiconductor ASA
# SPDX-License-Identifier: Apache-2.0

source "Kconfig.zephyr"

config SAMPLE_INST_COUNT
	int "Number of instances to spawn"
	default 2
```
